## CMakeLists.txt
```
cmake_minimum_required(VERSION 3.20.0)
find_package(Zephyr REQUIRED HINTS $ENV{ZEPHYR_BASE})
project(toolkit)

target_compile_definitions(app PUBLIC __ZEPHYR__)

# Define path to vglite_window folder
set(VGLITE_WINDOW_DIR ${CMAKE_CURRENT_SOURCE_DIR}/../vglite_window)

# Define path to soc folder
set(VGLITE_EXAMPLES_SOC_DIR ${CMAKE_CURRENT_SOURCE_DIR}/../soc)

# Define path to vglite_layer folder
set(VGLITE_LAYER_DIR ${CMAKE_CURRENT_SOURCE_DIR}/../vglite_layer)

# Define path to qoi folder
set(QOI_DIR ${CMAKE_CURRENT_SOURCE_DIR}/../qoi)

# Add sources
target_sources(app PRIVATE
    src/main.c
    ${VGLITE_WINDOW_DIR}/vglite_window.c
    ${VGLITE_LAYER_DIR}/vglite_layer.c
)

# Include directories
target_include_directories(app PRIVATE ${VGLITE_WINDOW_DIR})
target_include_directories(app PRIVATE ${VGLITE_LAYER_DIR})
target_include_directories(app PRIVATE ${QOI_DIR})

# Path to gpu-vglite repo: modules/gpu-vglite
set(GPU_VGLITE_DIR ${ZEPHYR_BASE}/../modules/gpu-vglite)

# Add gpu-vglite so its CMakeLists.txt is processed
add_subdirectory(${GPU_VGLITE_DIR} ${CMAKE_CURRENT_BINARY_DIR}/gpu-vglite)

# Link libraries
target_link_libraries(app PRIVATE vglite)

# Explicitly link kernel library after vglite
target_link_libraries(app PRIVATE ${CMAKE_BINARY_DIR}/zephyr/kernel/libkernel.a)

target_link_libraries(app PRIVATE zephyr_interface)

# Zephyr-specific include directories
zephyr_include_directories(${CMAKE_CURRENT_SOURCE_DIR}/include)
zephyr_include_directories(${ZEPHYR_BASE}/include)
zephyr_include_directories(${ZEPHYR_BASE}/include/zephyr)

if(EXISTS ${VGLITE_EXAMPLES_SOC_DIR})
  if(CONFIG_SOC_SERIES_IMXRT11XX)
    target_include_directories(vglite PRIVATE ${VGLITE_EXAMPLES_SOC_DIR}/mimxrt1170)

  elseif(CONFIG_SOC_SERIES_IMXRT5XX)
    target_include_directories(vglite PRIVATE ${VGLITE_EXAMPLES_SOC_DIR}/mimxrt595)
    zephyr_linker_sources(SECTIONS ${ZEPHYR_BASE}/boards/nxp/mimxrt595_evk/dc_ram.ld)

  elseif(CONFIG_SOC_SERIES_IMXRT7XX)
    target_include_directories(vglite PRIVATE ${VGLITE_EXAMPLES_SOC_DIR}/mimxrt700)
    zephyr_linker_sources(SECTIONS ${VGLITE_EXAMPLES_SOC_DIR}/mimxrt700/psram_sections.ld)

  endif()
endif()
```

## prj.conf
```kconfig
CONFIG_LOG=y
CONFIG_LOG_MODE_IMMEDIATE=y
CONFIG_CONSOLE=y
CONFIG_PRINTK=y
CONFIG_HEAP_MEM_POOL_SIZE=262144
CONFIG_DISPLAY=y
CONFIG_GPU_DEV=y
CONFIG_GPU_DEV_NAME="GPU"
CONFIG_PM_DEVICE=y
CONFIG_VG_LITE_K_MEM_POOL_SIZE=0x200000
CONFIG_GPU_CLOCK_KHZ=996000
CONFIG_VGLITE=y
```

## boards/mimxrt595_evk_mimxrt595s_cm33.conf
```kconfig
# Copyright 2023, 2026 NXP
# SPDX-License-Identifier: Apache-2.0

CONFIG_VGLITE_TESS_WIDTH=720
CONFIG_VGLITE_TESS_HEIGHT=256
CONFIG_SYS_CLOCK_HW_CYCLES_PER_SEC=300000000
```

## src/main.c
```c
/*
 * Copyright 2019, 2021, 2024-2026 NXP
 * All rights reserved.
 *
 * SPDX-License-Identifier: BSD-3-Clause
 */

#include <zephyr/kernel.h>
#include <zephyr/device.h>
#include <zephyr/drivers/display.h>
#include <zephyr/sys/printk.h>
#include <zephyr/sys/util.h>
#include "vglite_layer.h"
#include "svgt12_test.h"

#include "vglite_window.h"
/*-----------------------------------------------------------*/
#include "vg_lite.h"

/*******************************************************************************
 * Definitions
 ******************************************************************************/
#define VGLITE_STACK_SIZE 			CONFIG_VGLITE_STACK_SIZE
#define VGLITE_PRIORITY   			K_HIGHEST_THREAD_PRIO
#define VGLITE_COMMAND_BUFFER_SZ 	(128 * 1024)

K_THREAD_STACK_DEFINE(vglite_stack, VGLITE_STACK_SIZE);
static struct k_thread vglite_thread;

/*******************************************************************************
 * Prototypes
 ******************************************************************************/
static void vglite_task(void *arg1, void *arg2, void *arg3);

/*******************************************************************************
 * Variables
 ******************************************************************************/
static vg_lite_display_t display;
static vg_lite_window_t window;

/* svg specific variables */
static vg_lite_matrix_t g_transform_matrix;
static int win_cx, win_cy;

static UILayers_t g_layers = UI_LAYER_DATA(svgt12_test);

/*******************************************************************************
 * Code
 ******************************************************************************/

int main(void)
{
	k_tid_t tid =
		k_thread_create(&vglite_thread, vglite_stack, K_THREAD_STACK_SIZEOF(vglite_stack),
				vglite_task, NULL, NULL, NULL, VGLITE_PRIORITY, 0, K_NO_WAIT);

	printk("Thread created, tid=%p\n", tid);

	while (1) {
		k_sleep(K_MSEC(1000));
	}
}

static void cleanup(void)
{
	vg_lite_error_t error;

	error = layer_free(&g_layers);
	if (error != VG_LITE_SUCCESS) {
		printk("\r\nERROR: layer_free failed for %s\r\n", g_layers.img_info->image_name);
	}

	gradient_cache_free();
	vg_lite_close();
}

static vg_lite_error_t init_vg_lite(vg_lite_display_t *display)
{
	vg_lite_error_t error = VG_LITE_SUCCESS;

	/* Initialize the window. */
	error = VGLITE_CreateWindow(display, &window);
	if (error) {
		printk("VGLITE_CreateWindow failed: VGLITE_CreateWindow() returned error %d\r\n",
		       error);
		return error;
	}

	return error;
}

static void redraw(void)
{
	vg_lite_buffer_t *rt = VGLITE_GetRenderTarget(&window);

	if (rt == NULL) {
		printk("vg_lite_get_renderTarget error\r\n");
		while (1) {
		}
	}

	/* Draw the path using the matrix. */
	vg_lite_clear(rt, NULL, 0xFFFFFFFFU);

	layer_draw(rt, &g_layers, &g_transform_matrix);
	VGLITE_SwapBuffers(&window);
}

void init_graphic_assets(void)
{
	int ret = 0;
	vg_lite_error_t error;
	static float sx, sy;

	win_cx = (int)(window.width / 2.0f);
	win_cy = (int)(window.height / 2.0f);

	sx = (window.width / 1.5f) / (g_layers.img_info->image_size[0]);
	sy = (window.height / 1.5f) / (g_layers.img_info->image_size[1]);

	float scale = (sx < sy) ? sx : sy;

	/* Calculate scaled image size */
	float scaled_width = g_layers.img_info->image_size[0] * scale;
	float scaled_height = g_layers.img_info->image_size[1] * scale;

	/* Calculate top-left position to center the image */
	float tx = win_cx - (scaled_width / 2.0f);
	float ty = win_cy - (scaled_height / 2.0f);

	vg_lite_identity(&g_transform_matrix);
	vg_lite_translate(tx, ty, &g_transform_matrix);
	vg_lite_scale(scale, scale, &g_transform_matrix);

	ret = layer_init(&g_layers);
	if (ret != VG_LITE_SUCCESS) {
		printk("\r\nERROR: layer_init failed for %s\r\n", g_layers.img_info->image_name);
	}

	error = gradient_cache_init();
	if (error != 0) {
		printk("init_cached_gradient failed: error %d\r\n", error);
		while (1) {
		}
	}
}

uint32_t getTime(void)
{
	return k_uptime_get_32(); /* milliseconds */
}

static void vglite_task(void *arg1, void *arg2, void *arg3)
{
	status_t status;
	vg_lite_error_t error;
	uint32_t startTime, time, n = 0, fps_x_1000;

	const struct device *display_dev;

	display_dev = DEVICE_DT_GET(DT_CHOSEN(zephyr_display));
	if (!device_is_ready(display_dev)) {
		printk("display device not ready\n");
		return;
	}

	display_blanking_off(display_dev);
	struct display_capabilities capabilities;

	display_get_capabilities(display_dev, &capabilities);

	vg_lite_display_t my_display = {.dev = display_dev,
					.width = capabilities.x_resolution,
					.height = capabilities.y_resolution};

	error = init_vg_lite(&my_display);
	if (error) {
		printk("init_vg_lite failed: init_vg_lite() returned error %d\n", error);
		while (1) {
		}
	}

	init_graphic_assets();

	startTime = getTime();
	while (1) {
		redraw();

		n++;
		if (n >= 60) {
			time = getTime() - startTime;
			fps_x_1000 = (n * 1000 * 1000) / time;
			printk("%d frames in %d mSec: %d.%d FPS\r\n", n, time, fps_x_1000 / 1000,
			       fps_x_1000 % 1000);
			n = 0;
			startTime = getTime();
		}
	}
}
```
