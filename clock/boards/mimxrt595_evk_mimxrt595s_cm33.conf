## clock/boards/mimxrt595_evk_mimxrt595s_cm33.conf
```kconfig
# Copyright 2023, 2026 NXP
# SPDX-License-Identifier: Apache-2.0

CONFIG_VGLITE_TESS_WIDTH=720
CONFIG_VGLITE_TESS_HEIGHT=128
```

## tiger/boards/mimxrt1170_evk_mimxrt1176_cm7.conf
```kconfig
# Copyright 2023, 2026 NXP
# SPDX-License-Identifier: Apache-2.0

CONFIG_VG_LITE_K_MEM_POOL_SIZE=0xA00000
CONFIG_VGLITE_CMD_BUF_SIZE=262144
CONFIG_VGLITE_TESS_HEIGHT=1280
CONFIG_VGLITE_TESS_WIDTH=720
```

## tiger/boards/mimxrt595_evk_mimxrt595s_cm33.conf
```kconfig
# Copyright 2023, 2026 NXP
# SPDX-License-Identifier: Apache-2.0

CONFIG_VGLITE_CMD_BUF_SIZE=262144
CONFIG_VGLITE_TESS_HEIGHT=256
CONFIG_VGLITE_TESS_WIDTH=720
CONFIG_SYS_CLOCK_HW_CYCLES_PER_SEC=300000000
```

## tiger/boards/mimxrt700_evk_mimxrt798s_cm33_cpu0.conf
```kconfig
# Copyright 2023, 2026 NXP
# SPDX-License-Identifier: Apache-2.0

CONFIG_VGLITE_CMD_BUF_SIZE=262144
CONFIG_VGLITE_TESS_HEIGHT=640
CONFIG_VGLITE_TESS_WIDTH=720
```
