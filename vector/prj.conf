## CMakeLists.txt
```
cmake_minimum_required(VERSION 3.20.0)
find_package(Zephyr REQUIRED HINTS $ENV{ZEPHYR_BASE})
project(vector)

target_compile_definitions(app PUBLIC __ZEPHYR__)

# Define path to vglite_window folder
set(VGLITE_WINDOW_DIR ${CMAKE_CURRENT_SOURCE_DIR}/../vglite_window)

# Define path to soc folder
set(VGLITE_EXAMPLES_SOC_DIR ${CMAKE_CURRENT_SOURCE_DIR}/../soc)

# Add sources
target_sources(app PRIVATE
    src/main.c
    ${VGLITE_WINDOW_DIR}/vglite_window.c
)

# Include directories
target_include_directories(app PRIVATE ${VGLITE_WINDOW_DIR})

# Path to gpu-vglite repo: modules/gpu-vglite
set(GPU_VGLITE_DIR ${ZEPHYR_BASE}/../modules/gpu-vglite)

# Add gpu-vglite so its CMakeLists.txt is processed
add_subdirectory(${GPU_VGLITE_DIR} ${CMAKE_CURRENT_BINARY_DIR}/gpu-vglite)

# Link libraries
target_link_libraries(app PRIVATE vglite)

# Explicitly link kernel library after vglite
target_link_libraries(app PRIVATE ${CMAKE_BINARY_DIR}/zephyr/kernel/libkernel.a)

target_link_libraries(app PRIVATE zephyr_interface)

# Zephyr-specific include directories
zephyr_include_directories(${CMAKE_CURRENT_SOURCE_DIR}/include)
zephyr_include_directories(${ZEPHYR_BASE}/include)
zephyr_include_directories(${ZEPHYR_BASE}/include/zephyr)

if(EXISTS ${VGLITE_EXAMPLES_SOC_DIR})
  if(CONFIG_SOC_SERIES_IMXRT11XX)
    target_include_directories(vglite PRIVATE ${VGLITE_EXAMPLES_SOC_DIR}/mimxrt1170)

  elseif(CONFIG_SOC_SERIES_IMXRT5XX)
    target_include_directories(vglite PRIVATE ${VGLITE_EXAMPLES_SOC_DIR}/mimxrt595)
    zephyr_linker_sources(SECTIONS ${ZEPHYR_BASE}/boards/nxp/mimxrt595_evk/dc_ram.ld)

  elseif(CONFIG_SOC_SERIES_IMXRT7XX)
    target_include_directories(vglite PRIVATE ${VGLITE_EXAMPLES_SOC_DIR}/mimxrt700)
    zephyr_linker_sources(SECTIONS ${VGLITE_EXAMPLES_SOC_DIR}/mimxrt700/psram_sections.ld)

  endif()
endif()
```

## prj.conf
```kconfig
CONFIG_LOG=y
CONFIG_LOG_MODE_IMMEDIATE=y
CONFIG_CONSOLE=y
CONFIG_PRINTK=y
CONFIG_HEAP_MEM_POOL_SIZE=262144
CONFIG_DISPLAY=y
CONFIG_GPU_DEV=y
CONFIG_GPU_DEV_NAME="GPU"
CONFIG_PM_DEVICE=y
CONFIG_VG_LITE_K_MEM_POOL_SIZE=0x200000
```

## src/main.c
```c
/*
 * Copyright 2019, 2021, 2024-2026 NXP
 * All rights reserved.
 *
 * SPDX-License-Identifier: BSD-3-Clause
 */

#include <zephyr/kernel.h>
#include <zephyr/device.h>
#include <zephyr/drivers/display.h>
#include <zephyr/sys/printk.h>
#include <zephyr/sys/util.h>

#include "vglite_window.h"
/*-----------------------------------------------------------*/
#include "vg_lite.h"

/*******************************************************************************
 * Definitions
 ******************************************************************************/
#define VGLITE_STACK_SIZE 			CONFIG_VGLITE_STACK_SIZE
#define VGLITE_PRIORITY   			K_HIGHEST_THREAD_PRIO

K_THREAD_STACK_DEFINE(vglite_stack, VGLITE_STACK_SIZE);
static struct k_thread vglite_thread;

/*******************************************************************************
 * Prototypes
 ******************************************************************************/
static void vglite_task(void *arg1, void *arg2, void *arg3);

/*******************************************************************************
 * Variables
 ******************************************************************************/
static vg_lite_display_t display;
static vg_lite_window_t window;

/*
 *	    *-----*
 *	   /       \
 *	  /         \
 *	 *           *
 *	 |          /
 *	 |         X
 *	 |          \
 *	 *           *
 *	  \         /
 *	   \       /
 *	    *-----*
 */
static int8_t path_data[] = {
	2, -5,  -10, /* moveto   -5, -10 */
	4, 5,   -10, /* lineto    5, -10 */
	4, 10,  -5,  /* lineto   10,  -5 */
	4, 0,   0,   /* lineto    0,   0 */
	4, 10,  5,   /* lineto   10,   5 */
	4, 5,   10,  /* lineto    5,  10 */
	4, -5,  10,  /* lineto   -5,  10 */
	4, -10, 5,   /* lineto   -10,  5 */
	4, -10, -5,  /* lineto   -10, -5 */
	0,           /* end */
};

static vg_lite_path_t path = {
	{
		-10, -10, /* left, top */
		10, 10    /* right, bottom */
	},
	VG_LITE_HIGH,      /* quality */
	VG_LITE_S8,        /* -128 to 127 coordinate range */
	{0},               /* uploaded */
	sizeof(path_data), /* path length */
	path_data,         /* path data */
	1                  /* path type */
};

static vg_lite_matrix_t matrix;
/*******************************************************************************
 * Code
 ******************************************************************************/

int main(void)
{
	k_tid_t tid =
		k_thread_create(&vglite_thread, vglite_stack, K_THREAD_STACK_SIZEOF(vglite_stack),
				vglite_task, NULL, NULL, NULL, VGLITE_PRIORITY, 0, K_NO_WAIT);

	printk("Thread created, tid=%p\n", tid);

	while (1) {
		k_sleep(K_MSEC(1000));
	}
}

static void cleanup(void)
{
	vg_lite_clear_path(&path);
	vg_lite_close();
}

static vg_lite_error_t init_vg_lite(vg_lite_display_t *display)
{
	vg_lite_error_t error = VG_LITE_SUCCESS;

	/* Initialize the window. */
	error = VGLITE_CreateWindow(display, &window);
	if (error) {
		printk("VGLITE_CreateWindow failed: VGLITE_CreateWindow() returned error %d\n",
		       error);
		return error;
	}

	return error;
}

static void redraw(void)
{
	vg_lite_error_t error = VG_LITE_SUCCESS;

	vg_lite_buffer_t *rt = VGLITE_GetRenderTarget(&window);

	if (rt == NULL) {
		printk("vg_lite_get_renderTarget error\r\n");
		while (1) {
		}
	}
	vg_lite_identity(&matrix);
	vg_lite_translate(window.width / 2.0f, window.height / 2.0f, &matrix);
	vg_lite_scale(10, 10, &matrix);

	vg_lite_clear(rt, NULL, 0xFFFF0000U);
	error = vg_lite_draw(rt, &path, VG_LITE_FILL_EVEN_ODD, &matrix, VG_LITE_BLEND_NONE,
			     0xFF0000FFU);
	if (error) {
		printk("vg_lite_draw() returned error %d\n", error);
		cleanup();
		return;
	}
	VGLITE_SwapBuffers(&window);
}

uint32_t getTime(void)
{
	return k_uptime_get_32(); /* milliseconds */
}

static void vglite_task(void *arg1, void *arg2, void *arg3)
{
	status_t status;
	vg_lite_error_t error;
	const struct device *display_dev;

	display_dev = DEVICE_DT_GET(DT_CHOSEN(zephyr_display));
	if (!device_is_ready(display_dev)) {
		printk("display device not ready\n");
		return;
	}

	display_blanking_off(display_dev);
	struct display_capabilities capabilities;

	display_get_capabilities(display_dev, &capabilities);

	vg_lite_display_t my_display = {.dev = display_dev,
					.width = capabilities.x_resolution,
					.height = capabilities.y_resolution};

	error = init_vg_lite(&my_display);
	if (error) {
		printk("init_vg_lite failed: init_vg_lite() returned error %d\n", error);
		while (1) {
		}
	}

	uint32_t startTime, time, n = 0;

	startTime = getTime();

	while (1) {
		redraw();
		if (n++ >= 59) {
			time = getTime() - startTime;
			printk("%d frames in %d seconds: %d fps\r\n", n, time / 1000,
			       n * 1000 / time);
			n = 0;
			startTime = getTime();
		}
	}
}
```
